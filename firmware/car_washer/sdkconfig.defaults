## firmware/car_washer/sdkconfig.defaults
```kconfig
CONFIG_LV_COLOR_DEPTH_16=y
CONFIG_LV_USE_CLIB_MALLOC=y
CONFIG_LV_USE_CLIB_STRING=y
CONFIG_LV_USE_CLIB_SPRINTF=y
CONFIG_LV_USE_QRCODE=y
CONFIG_LV_FONT_MONTSERRAT_14=y
# CONFIG_XPT2046_CONVERT_ADC_TO_COORDS is not set
CONFIG_XPT2046_Z_THRESHOLD=400
CONFIG_MQTT_PROTOCOL_5=y
CONFIG_ESP_NETIF_SET_DNS_PER_DEFAULT_NETIF=y
```
